#include "stm32_server_serial.h"

#include <stdio.h>
#include "server_control.h"
#include <string.h>
#include "rt_task.h"

// ##stm32 
#include "usart.h"
#include "misc.h"
#include "stm32f10x_usart.h"
#include "stm32f10x.h"

#if defined(__GNUC__) || defined(__clang__)
#define FUNC_NAME __PRETTY_FUNCTION__
#elif defined(_MSC_VER)
#define FUNC_NAME __FUNCTION__
#else
#define FUNC_NAME __func__
#endif

#define PRINT_FUNC              printf("Recive: [%s] \n", FUNC_NAME)

bool g_isRunning = false;
bool g_isLoop = false;
bool Send(const unsigned char* data, const int bodyLen)
{
    int index = 0;
    for (index; index < bodyLen; ++index)
    {
        USART_SendData(USART1, data[index]); //向串口1发送数据
        while (USART_GetFlagStatus(USART1, USART_FLAG_TC) != SET); //等待发送结束
    }

    return true;
}

void Connected(void)
{
    PRINT_FUNC;
    g_isRunning = true;
}

void Disconnected(void)
{
    PRINT_FUNC;
    GetGlobalControlPtr()->Stop(GetGlobalControlPtr());
}

bool InitSerial()
{
    NVIC_PriorityGroupConfig(NVIC_PriorityGroup_2);
    delay_init();
    //LED_Init();
    uart_init(115200);

    return true;
}

void StartListen(void)
{
    if (!IsOpen() || IsRunning())
    {
        return;
    }

    uint16_t byteLen = 0;
    Connected();
    while (g_isRunning)
    {
		delay_ms(20);
        if (IsStart())
        {
            SingleStep();
        }

        if (USART_RX_STA & 0x8000) // 接收到完整帧
        {
            byteLen = USART_RX_STA & 0x3fff;
            LoopRecvMsg(USART_RX_BUF, byteLen);

            USART_RX_STA = 0;
        }
    }
    GetGlobalControlPtr()->Stop(GetGlobalControlPtr());
}

bool IsOpen(void)
{
    return true;
}

bool IsRunning(void)
{
    return g_isRunning;
}
